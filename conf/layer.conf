## conf/layer.conf
```bitbake
# We have a conf and classes directory, add to BBPATH
BBPATH .= ":${LAYERDIR}"

# We have recipes-* directories, add to BBFILES
BBFILES += "${LAYERDIR}/recipes-*/*/*.bb \
            ${LAYERDIR}/recipes-*/*/*.bbappend"

BBFILE_COLLECTIONS += "meta-mark"
BBFILE_PATTERN_meta-mark = "^${LAYERDIR}/"
BBFILE_PRIORITY_meta-mark = "6"

LAYERDEPENDS_meta-mark = "core"
LAYERSERIES_COMPAT_meta-mark = "scarthgap"
```
